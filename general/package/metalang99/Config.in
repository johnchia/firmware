## general/package/metalang99/Config.in
```kconfig
config BR2_PACKAGE_METALANG99
	bool "metalang99"
	help
	  A metaprogramming library for pure C99/C11, powering
	  Hirrolot's Datatype99/Interface99.

	  Header/macro-only build dependency, vendored here purely so
	  its extracted source tree can be handed to a dependent
	  package's CMake FetchContent as an offline override -- it
	  installs nothing to the target itself.

	  https://github.com/Hirrolot/metalang99
```

## general/package/raptor-streaming/Config.in
```kconfig
config BR2_PACKAGE_RAPTOR_STREAMING
	bool "Raptor streaming system"
	select BR2_PACKAGE_COMPY
	select BR2_PACKAGE_FAAC
	select BR2_PACKAGE_HELIX_AAC
	select BR2_PACKAGE_LIBSCHRIFT
	select BR2_PACKAGE_MAJESTIC_FONTS
	select BR2_PACKAGE_OPUS
	help
	  Multi-daemon streaming system: video, RTSP, audio, OSD and
	  day/night control, talking to the SoC through a pluggable HAL.

	  Raptor is developed as four sibling repositories, each pinned
	  by commit in raptor-streaming.mk, plus the sigmastar-headers
	  submodule the HAL reaches for the MI declarations. The build
	  fetches all five, so no checkout is needed.

	  https://github.com/gtxaspec/raptor
```

## general/package/sigmastar-boot/Config.in
```kconfig
config BR2_PACKAGE_SIGMASTAR_BOOT
	bool "sigmastar-boot"
	depends on BR2_TARGET_UBOOT
	help
	  Board hooks for Buildroot's U-Boot package on SigmaStar.

	  U-Boot builds u-boot.bin; a SigmaStar board boots a container --
	  IPL, GCIS, IPL_CUST, SNI and the compressed payload -- which the
	  vendor's make_boot_spinor.sh assembles. This runs it, checks that
	  it produced something (nothing in that chain sets -e, and a
	  container with no payload writes cleanly and never boots), and
	  installs the result as images/u-boot-<soc>-nor.bin.

	  It also carries the version string the board reports, the SoC
	  macro the vendor tree expects as a compiler flag, and the rsync
	  exclusions that make UBOOT_SRCDIR builds repeatable.

	  Not part of the sysupgrade tarball: mtd0 has no software recovery
	  path, so writing it is a deliberate act with a programmer to hand.
	  `make fullimage` picks it up.
```

## general/package/sigmastar-uboot/Config.in
```kconfig
config BR2_PACKAGE_SIGMASTAR_UBOOT
	bool "sigmastar-uboot"
	help
	  SigmaStar's U-Boot 2015.01, built from the OpenIPC fork at
	  github.com/johnchia/u-boot-sigmastar, which adds a MAC address
	  derived from the NOR part's factory unique ID (infinity6c
	  only). Without it every board answers to the shared fallback
	  00:00:23:34:45:66.

	  Emits images/u-boot-<soc>-nor.bin -- the whole boot container
	  (IPL, GCIS, IPL_CUST, SNI, u-boot), not just u-boot.bin. It is
	  not part of the sysupgrade tarball: mtd0 has no software
	  recovery path, so writing it is a deliberate act with a
	  programmer to hand. `make fullimage` picks it up.

	  https://github.com/johnchia/u-boot-sigmastar
```

## general/package/slice99/Config.in
```kconfig
config BR2_PACKAGE_SLICE99
	bool "slice99"
	help
	  A C99 library for array slices.

	  Header/macro-only build dependency, vendored here purely so
	  its extracted source tree can be handed to a dependent
	  package's CMake FetchContent as an offline override -- it
	  installs nothing to the target itself.

	  https://github.com/Hirrolot/slice99
```
