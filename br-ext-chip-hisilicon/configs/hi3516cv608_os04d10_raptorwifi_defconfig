## general/Config.in
```kconfig
config BR2_OPENIPC_SOC_VENDOR
	string "SoC vendor"

config BR2_OPENIPC_SOC_MODEL
	string "SoC model"

config BR2_OPENIPC_SOC_ALIASES
	string "Interchangeable SoC ids served by this image"
	help
	  Space-separated retired/hardware-compatible SoC ids that this build's
	  SOC_MODEL also serves (e.g. "hi3516cv610 hi3516cv608" on the cv6xx
	  image, or "xm550" on the xm530 image). Read by
	  .github/scripts/enrich_manifest.py to emit @alias records so on-device
	  sysupgrade routes a camera still reporting the old id to the image
	  actually published under SOC_MODEL.

config BR2_OPENIPC_SOC_FAMILY
	string "SoC family"

config BR2_OPENIPC_SNS_MODEL
	string "Sensor model"

config BR2_OPENIPC_CAMERA
	string "Camera"
	help
	  Set only by a camera fragment, br-ext-chip-<vendor>/cameras/<camera>/
	  camera.conf, to the directory's own name: <identity>_<soc>_<sensor>_
	  <radio>. Names the image archive (openipc.<camera>-nor-<variant>) and
	  is stamped into os-release as BUILD_CAMERA so the camera-side updater
	  can compose that name back. Empty on an SoC target.

config BR2_OPENIPC_CAMERA_BASE
	string "Camera base target"
	help
	  The SoC target a camera fragment layers on, as <soc>_<variant>; the
	  Makefile reads it out of camera.conf to find the defconfig. A camera
	  may set only camera facts over its base (the allowlist is in
	  .github/scripts/test_cameras.sh); a fragment that wants more is an
	  SoC target in disguise.

config BR2_OPENIPC_VARIANT
	string "OpenIPC variant"

config BR2_OPENIPC_FLASH_SIZE
	string "OpenIPC flash size"

config BR2_OPENIPC_ROOTFS_PART_KB
	string "OpenIPC rootfs partition size in KB"
	help
	  Size of the rootfs MTD partition in KB, for boards whose partition
	  table does not follow from the size of the flash chip -- a 16MB NOR
	  that gives the rootfs 5MB and the remaining 8.5MB to the overlay, for
	  example. The build's size limit is a property of the partition the
	  image has to fit in, not of the chip.

	  Leave empty to derive the limit from BR2_OPENIPC_FLASH_SIZE as before.

config BR2_OPENIPC_MAJESTIC
	string "OpenIPC Majestic"
	default "lite"

source "$BR2_EXTERNAL_GENERAL_PATH/package/Config.in"
```

## general/package/compy/Config.in
```kconfig
config BR2_PACKAGE_COMPY
	bool "compy"
	help
	  A small, portable RTSP 1.0 server library in C99 for embedded
	  IP cameras: RTCP, SRTP/SRTCP, RTSPS, Digest auth, ONVIF
	  backchannel, H.264/H.265. Linked by Raptor's RTSP daemon and
	  by Divinus.

	  Static library, staging only: nothing is installed into the
	  rootfs.

	  https://github.com/gtxaspec/compy
```

## general/package/datatype99/Config.in
```kconfig
config BR2_PACKAGE_DATATYPE99
	bool "datatype99"
	select BR2_PACKAGE_METALANG99
	help
	  Sum types (a.k.a. tagged unions) for C99/C11.

	  Header/macro-only build dependency, vendored here purely so
	  its extracted source tree can be handed to a dependent
	  package's CMake FetchContent as an offline override -- it
	  installs nothing to the target itself.

	  https://github.com/Hirrolot/datatype99
```

## general/package/faac/Config.in
```kconfig
config BR2_PACKAGE_FAAC
	bool "faac"
	help
	  Freeware Advanced Audio Coder -- an AAC encoder, providing
	  AAC-LC and HE-AAC v1 (AAC-LC plus SBR).

	  Not in Buildroot's own package set, and the version matters: the
	  modern releases build with Meson and expose a different API
	  (faac_encoder_open / faac_params_init) from the faacEnc* one that
	  distributions carried for years. Raptor's rad uses the modern
	  API, so this package tracks the commit Raptor's own
	  build-standalone.sh pins.

	  https://github.com/knik0/faac
```

## general/package/helix-aac/Config.in
```kconfig
config BR2_PACKAGE_HELIX_AAC
	bool "helix-aac"
	help
	  RealNetworks' fixed-point HE-AAC decoder, built from the copy
	  vendored in the ESP8266Audio library. Linked by Raptor's RTSP
	  daemon to decode AAC on the ONVIF backchannel.

	  Static library, staging only: nothing is installed into the
	  rootfs.

	  https://github.com/earlephilhower/ESP8266Audio
```

## general/package/hisilicon-cv6xx-boot/Config.in
```kconfig
config BR2_PACKAGE_HISILICON_CV6XX_BOOT
	bool "hisilicon-cv6xx-boot"
	depends on BR2_TARGET_UBOOT
	help
	  Board hooks for Buildroot's U-Boot package on the Hi3516CV6xx.

	  U-Boot builds u-boot.bin; the boot ROM loads a signed boot
	  image -- the GSL loader, the board's DDR register table and the
	  compressed U-Boot -- which the vendor's image_tool assembles.
	  This compresses U-Boot with the vendor's hi-gzip, builds the GSL
	  from the tree's own source, packs the three with image_tool,
	  checks the result and installs it as
	  images/u-boot-<soc>-nor.bin.

	  The source is OpenIPC/u-boot-hi3516cv6xx, pinned in the board
	  defconfig: https://github.com/OpenIPC/u-boot-hi3516cv6xx

	  Not part of the sysupgrade tarball: mtd0 has no software
	  recovery path short of the boot ROM's UART download, so writing
	  it is a deliberate act. `make fullimage` picks it up.

config BR2_PACKAGE_HISILICON_CV6XX_BOOT_BOARD_REGS
	string "register records the SoC target appends to the boot reg table"
	depends on BR2_PACKAGE_HISILICON_CV6XX_BOOT
	default ""
	help
	  A file of register writes the boot ROM applies after the DDR
	  table and before anything else runs: one "ADDR VALUE" per
	  line, '#' comments, optional DELAY and ATTR fields (default 0
	  and 0xfd, a plain write). The reference table leaves every
	  pad it does not use at the SoC's reset state, which is pulled
	  up, and a vendor bootloader drives the ones that matter before
	  Linux. This is where the image does the same for the whole
	  family: a pad that lights a lamp on every board seen is pulled
	  down here, so nothing is on until a daemon asks. Named by the
	  SoC defconfig, kept beside its device tree:
	  "$(EXTERNAL_VENDOR)/board/<family>/<soc>.boot-regs.txt".

config BR2_PACKAGE_HISILICON_CV6XX_BOOT_REGS
	string "register records a camera appends to the boot reg table"
	depends on BR2_PACKAGE_HISILICON_CV6XX_BOOT
	default ""
	help
	  The same format as BR2_PACKAGE_HISILICON_CV6XX_BOOT_BOARD_REGS,
	  applied after it. A camera uses it to park pads the reference
	  table leaves on a function the board does not want -- the
	  enable of a driver chip, a bus with nothing on it -- the way
	  its vendor bootloader did. Board facts, so it lives in the
	  camera directory: "$(OPENIPC_CAMERA_DIR)/boot-regs.txt".
```

## general/package/hisilicon-opensdk/Config.in
```kconfig
config BR2_PACKAGE_HISILICON_OPENSDK
	bool "hisilicon-opensdk"
	default n
	depends on BR2_LINUX_KERNEL
	help
	  Opensource Hisilicon SoCs SDK

	  https://github.com/johnchia/openhisilicon (branch cv608-4m-encoder:
	  https://github.com/OpenIPC/openhisilicon plus one CV608 encoder commit)

comment "HISILICON_OPENSDK needs a Linux kernel to be built"
	depends on !BR2_LINUX_KERNEL
```

## general/package/ingenic-musl-shim/Config.in
```kconfig
config BR2_PACKAGE_INGENIC_MUSL_SHIM
	bool "ingenic-musl-shim"
	depends on BR2_TOOLCHAIN_USES_MUSL
	help
	  The libc symbols Ingenic's libimp.so and libalog.so were linked
	  against and musl does not define.

	  The vendor libraries are uClibc builds, so they leave
	  __assert, __fgetc_unlocked, __pthread_register_cancel and
	  __pthread_unregister_cancel undefined as strong references. On a
	  musl image nothing resolves them, and the program that loads
	  libimp fails at relocation rather than at a call site.

	  Static archive, staging only: the consumer links it with
	  --whole-archive --export-dynamic so the symbols are exported from
	  the executable, which is where the vendor library looks for them.

	  https://github.com/gtxaspec/ingenic-musl
```

## general/package/ingenic-uboot/Config.in
```kconfig
config BR2_PACKAGE_INGENIC_UBOOT
	bool "ingenic-uboot"
	depends on BR2_TARGET_UBOOT
	help
	  Board hooks for Buildroot's U-Boot package on Ingenic T-series.

	  The Ingenic U-Boot device tree is per-SoC, but the SD-slot power,
	  card-detect and reset-button lines are per-board. This injects them
	  into the build copy of the leaf .dts. Without them U-Boot never
	  powers or detects the card slot, so the bootloader's SD-card
	  recovery path does nothing -- which on a camera with no Ethernet
	  and no serial header is the difference between recoverable and a
	  SPI clip.

if BR2_PACKAGE_INGENIC_UBOOT

config BR2_PACKAGE_INGENIC_UBOOT_GPIO_MMC_CD
	string "SD card-detect gpio"
	default "-1"
	help
	  Board gpio number wired to the card-detect switch, or -1 if the
	  board has none (U-Boot then keeps the dtsi's broken-cd probe).

config BR2_PACKAGE_INGENIC_UBOOT_GPIO_MMC_POWER
	string "SD slot power gpio"
	default "-1"
	help
	  Board gpio number gating power to the SD slot, or -1 if the slot
	  is permanently powered.

config BR2_PACKAGE_INGENIC_UBOOT_GPIO_MMC_POWER_ACTIVE_LOW
	bool "SD slot power gpio is active low"
	help
	  Say y when the slot is powered by driving the gpio low.

config BR2_PACKAGE_INGENIC_UBOOT_GPIO_BUTTON_RESET
	string "Factory-reset button gpio"
	default "-1"
	help
	  Board gpio number of the reset button, or -1 if the board has
	  none. CONFIG_BUTTON_CMD reads it once early in main_loop and runs
	  button_cmd_0 from the environment if it is held at boot.

endif
```

## general/package/interface99/Config.in
```kconfig
config BR2_PACKAGE_INTERFACE99
	bool "interface99"
	select BR2_PACKAGE_METALANG99
	help
	  Interfaces (a.k.a. virtual functions, dynamic/ad-hoc
	  polymorphism, type classes, or trait objects) for C99/C11.

	  Header/macro-only build dependency, vendored here purely so
	  its extracted source tree can be handed to a dependent
	  package's CMake FetchContent as an offline override -- it
	  installs nothing to the target itself.

	  https://github.com/Hirrolot/interface99
```

## general/package/ipctool/Config.in
```kconfig
config BR2_PACKAGE_IPCTOOL
	bool "ipctool"
	help
	  ipctool - IP cameras chip information tool

	  https://github.com/johnchia/ipctool/ (fork of
	  https://github.com/openipc/ipctool/, pinned for the V5 die-ID reader)
```

## general/package/libschrift/Config.in
```kconfig
config BR2_PACKAGE_LIBSCHRIFT
	bool "libschrift"
	help
	  Lightweight TrueType font rendering library.

	  Static library, staging only: nothing is installed into the
	  rootfs. Selected by packages that rasterise text on the device,
	  such as Raptor's OSD daemon.

	  https://github.com/tomolt/libschrift
```

## general/package/mbedtls3-openipc/Config.in
```kconfig
config BR2_PACKAGE_MBEDTLS3_OPENIPC
	bool "mbedtls3-openipc"
	help
	  Mbed TLS 3.6 LTS, the successor to the 2.x branch that
	  mbedtls-openipc pins. Both can be installed at once: the two
	  release series carry different SONAMEs, so nothing on the
	  target collides.

	  Select this for new code. mbedtls-openipc stays for the
	  Majestic blob, which is linked against the 2.x SONAMEs and
	  cannot be rebuilt.

	  A process must load one series or the other, never both --
	  the two libraries export the same symbol names.

	  https://github.com/Mbed-TLS/mbedtls

if BR2_PACKAGE_MBEDTLS3_OPENIPC

config BR2_PACKAGE_MBEDTLS3_OPENIPC_PROGRAMS
	bool "mbedtls3-openipc programs"
	depends on BR2_USE_MMU # fork()
	help
	  This option enables the installation and the build of
	  Mbed TLS companion programs.

endif
```
